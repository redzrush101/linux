## Documentation/devicetree/bindings/clock/qcom,palawan-gcc.yaml
```yaml
# SPDX-License-Identifier: (GPL-2.0-only OR BSD-2-Clause)
%YAML 1.2
---
$id: http://devicetree.org/schemas/clock/qcom,palawan-gcc.yaml#
$schema: http://devicetree.org/meta-schemas/core.yaml#

title: Qualcomm Global Clock & Reset Controller on Palawan

maintainers:
  - Alexandr Zubtsov <devizure@mainlining.org>

description: |
  Qualcomm global clock control module provides the clocks, resets and power
  domains on Palawan

  See also:: include/dt-bindings/clock/qcom,palawan-gcc.h

properties:
  compatible:
    const: qcom,palawan-gcc

  clocks:
    items:
      - description: Board XO source
      - description: Board Always On XO source
      - description: Sleep clock source
      - description: PCIE 0 Pipe clock source
      - description: UFS Phy Rx symbol 0 clock source
      - description: UFS Phy Rx symbol 1 clock source
      - description: UFS Phy Tx symbol 0 clock source
      - description: USB3 Phy wrapper pipe clock source

required:
  - compatible
  - clocks
  - '#power-domain-cells'

allOf:
  - $ref: qcom,gcc.yaml#

unevaluatedProperties: false

examples:
  - |
    #include <dt-bindings/clock/qcom,rpmh.h>
    clock-controller@100000 {
      compatible = "qcom,palawan-gcc";
      reg = <0x00100000 0x1f4200>;
      clocks = <&bi_tcxo_div2>,
               <&bi_tcxo_ao_div2>,
               <&sleep_clk>,
               <&pcie0_phy>,
               <&ufs_mem_phy 0>,
               <&ufs_mem_phy 1>,
               <&ufs_mem_phy 2>,
               <&usb_1_qmpphy>;
      #clock-cells = <1>;
      #reset-cells = <1>;
      #power-domain-cells = <1>;
    };

...
```

## Documentation/devicetree/bindings/display/panel/novatek,nt37706.yaml
```yaml
# SPDX-License-Identifier: GPL-2.0-only OR BSD-2-Clause
%YAML 1.2
---
$id: http://devicetree.org/schemas/display/panel/novatek,nt37706.yaml#
$schema: http://devicetree.org/meta-schemas/core.yaml#

title: Novatek NT37706 based AMOLED DSI panels

maintainers:
  - Yassin Rezai <yassinrsocial@proton.me>

description:
  The Novatek NT37706 is a display driver IC for AMOLED DSI panels using
  Display Stream Compression. The panel specific compatible selects the
  initialization sequence.

allOf:
  - $ref: panel-common.yaml#

properties:
  compatible:
    items:
      - enum:
          - xiaomi,peridot-csot-nt37706
      - const: novatek,nt37706

  reg:
    maxItems: 1
    description: DSI virtual channel

  vddio-supply:
    description: 1.8V I/O supply

  vdd-supply:
    description: 1.2V digital core supply

  vci-supply:
    description: 3.0V analog supply

  port: true
  reset-gpios: true

required:
  - compatible
  - reg
  - vddio-supply
  - vdd-supply
  - vci-supply
  - reset-gpios
  - port

additionalProperties: false

examples:
  - |
    #include <dt-bindings/gpio/gpio.h>

    dsi {
        #address-cells = <1>;
        #size-cells = <0>;

        panel@0 {
            compatible = "xiaomi,peridot-csot-nt37706", "novatek,nt37706";
            reg = <0>;

            vddio-supply = <&vreg_l8b_1p8>;
            vdd-supply = <&panel_vdd_1p2>;
            vci-supply = <&vreg_l19b_3p0>;

            reset-gpios = <&tlmm 13 GPIO_ACTIVE_LOW>;

            port {
                endpoint {
                    remote-endpoint = <&dsi0_out>;
                };
            };
        };
    };
...
```

## Documentation/devicetree/bindings/pinctrl/mediatek,mt6765-pinctrl.yaml
```yaml
# SPDX-License-Identifier: (GPL-2.0-only OR BSD-2-Clause)
%YAML 1.2
---
$id: http://devicetree.org/schemas/pinctrl/mediatek,mt6765-pinctrl.yaml#
$schema: http://devicetree.org/meta-schemas/core.yaml#

title: MediaTek MT6765 Pin Controller

maintainers:
  - Sean Wang <sean.wang@kernel.org>

properties:
  compatible:
    const: mediatek,mt6765-pinctrl

  reg:
    items:
      - description: GPIO controller registers
      - description: IO configuration bank 1
      - description: IO configuration bank 2
      - description: IO configuration bank 3
      - description: IO configuration bank 4
      - description: IO configuration bank 5
      - description: IO configuration bank 6
      - description: IO configuration bank 7
      - description: External interrupt controller registers

  reg-names:
    items:
      - const: iocfg0
      - const: iocfg1
      - const: iocfg2
      - const: iocfg3
      - const: iocfg4
      - const: iocfg5
      - const: iocfg6
      - const: iocfg7
      - const: eint

  gpio-controller: true

  '#gpio-cells':
    const: 2

  gpio-ranges:
    maxItems: 1

  interrupt-controller: true

  '#interrupt-cells':
    const: 2

  interrupts:
    maxItems: 1

patternProperties:
  '-pins$':
    type: object
    additionalProperties: false
    patternProperties:
      '^pins':
        type: object
        $ref: /schemas/pinctrl/pincfg-node.yaml
        properties:
          pinmux: true

          bias-pull-up: true

          bias-pull-down: true

          input-enable: true

          drive-strength:
            minimum: 0
            maximum: 7
        required:
          - pinmux
        additionalProperties: false

required:
  - compatible
  - reg
  - reg-names
  - gpio-controller
  - '#gpio-cells'
  - gpio-ranges
  - interrupt-controller
  - '#interrupt-cells'
  - interrupts

additionalProperties: false
```

## Documentation/devicetree/bindings/pinctrl/qcom,palawan-tlmm.yaml
```yaml
# SPDX-License-Identifier: (GPL-2.0-only OR BSD-2-Clause)
%YAML 1.2
---
$id: http://devicetree.org/schemas/pinctrl/qcom,palawan-tlmm.yaml#
$schema: http://devicetree.org/meta-schemas/core.yaml#

title: Qualcomm Technologies, Inc. Palawan TLMM block

maintainers:
  - Alexandr Zubtsov <devizure@mainlining.org>

description:
  Top Level Mode Multiplexer pin controller in Qualcomm Palawan SoC.

allOf:
  - $ref: /schemas/pinctrl/qcom,tlmm-common.yaml#

properties:
  compatible:
    const: qcom,palawan-tlmm

  reg:
    maxItems: 1

  interrupts:
    maxItems: 1

  gpio-reserved-ranges:
    minItems: 1
    maxItems: 105

  gpio-line-names:
    maxItems: 178

patternProperties:
  "-state$":
    oneOf:
      - $ref: "#/$defs/qcom-palawan-tlmm-state"
      - patternProperties:
          "-pins$":
            $ref: "#/$defs/qcom-palawan-tlmm-state"
        additionalProperties: false

$defs:
  qcom-palawan-tlmm-state:
    type: object
    description:
      Pinctrl node's client devices use subnodes for desired pin configuration.
      Client device subnodes use below standard properties.
    $ref: qcom,tlmm-common.yaml#/$defs/qcom-tlmm-state
    unevaluatedProperties: false

    properties:
      pins:
        description:
          List of gpio pins affected by the properties specified in this
          subnode.
        items:
          oneOf:
            - pattern: "^gpio([0-9]|[1-9][0-9]|1[0-9][0-9]|17[0-8])$"
            - enum: [ ufs_reset ]
        minItems: 1
        maxItems: 36

      function:
        description:
          Specify the alternative function to be configured for the specified
          pins.
        enum: [ gpio, HOST2WLAN_SOL, RESOUT_GPIO_N, aoss_cti, atest_char,
                atest_usb, audio_ext_mclk0, audio_ext_mclk1, audio_ref_clk,
                cam_aon_mclk4, cam_mclk, cci_async_in, cci_i2c_scl, cci_i2c_sda,
                cci_timer, cri_trng, coex_uart1_rx, coex_uart1_tx, coex_uart2_rx,
                coex_uart2_tx, dbg_out_clk, ddr_bist_complete, ddr_bist_fail,
                ddr_bist_start, ddr_bist_stop, ddr_pxi0, ddr_pxi1, ddr_pxi2,
                ddr_pxi3, dp_hot, egpio, gcc_gp1, gcc_gp2, gcc_gp3, gnss_adc0,
                gnss_adc1, i2s0_data0, i2s0_data1, i2s0_sck, i2s0_ws, i2s1_data0,
                i2s1_data1, i2s1_sck, i2s1_ws, ibi_i3c, jitter_bist, mdp_vsync0_out,
                mdp_vsync1_out, mdp_vsync2_out, mdp_vsync3_out, mdp_vsync_e,
                mdp_vsync_p, mdp_vsync_s, nav_gpio0, nav_gpio1, nav_gpio2, nav_gpio3,
                pcie0_clk_req_n, phase_flag, pll_bist_sync, pll_clk_aux,
                prng_rosc0, prng_rosc1, prng_rosc2, prng_rosc3, qdss_cti, qdss_gpio,
                qlink_big_enable, qlink_big_request, qlink_little_enable, qlink_little_request,
                qlink_wmss, qspi0_clk, qspi0_cs, qspi0_data, qup0_se0, qup0_se1,
                qup0_se2, qup0_se3, qup0_se4, qup0_se5, qup0_se6, qup0_se7,
                qup1_se0, qup1_se1, qup1_se2, qup1_se3, qup1_se4, qup1_se5,
                qup1_se6, qup1_se7, sd_write_protect, sdc2_data, sdc2_clk,
                sdc2_cmd, sdc2_fb_clk, tb_trig_sdc2, tgu_ch0_trigout, tgu_ch1_trigout,
                tgu_ch2_trigout, tgu_ch3_trigout, tmess_prng0, tmess_prng1,
                tmess_prng2, tmess_prng3, tsense_pwm1, tsense_pwm2, tsense_pwm3,
                uim0_clk, uim0_data, uim0_present, uim0_reset, uim1_clk,
                uim1_data, uim1_present, uim1_reset, usb0_hs, usb0_phy_ps,
                vfr_0, vfr_1, vsense_trigger_mirnat, ]

    required:
      - pins

required:
  - compatible
  - reg

unevaluatedProperties: false

examples:
  - |
    #include <dt-bindings/interrupt-controller/arm-gic.h>
    tlmm: pinctrl@f100000 {
        compatible = "qcom,palawan-tlmm";
        reg = <0x0f100000 0x300000>;

        interrupts = <GIC_SPI 208 IRQ_TYPE_LEVEL_HIGH 0>;

        gpio-controller;
        #gpio-cells = <2>;

        interrupt-controller;
        #interrupt-cells = <2>;

        gpio-ranges = <&tlmm 0 0 179>;

        gpio-wo-state {
            pins = "gpio1";
            function = "gpio";
        };

        uart-w-state {
            rx-pins {
                pins = "gpio83";
                function = "qup0_se5";
                bias-pull-up;
            };

            tx-pins {
                pins = "gpio82";
                function = "qup0_se5";
                bias-disable;
            };
        };
    };
...
```

## Documentation/devicetree/bindings/pinctrl/qcom,qcs615-lpass-lpi-pinctrl.yaml
```yaml
# SPDX-License-Identifier: (GPL-2.0-only OR BSD-2-Clause)
%YAML 1.2
---
$id: http://devicetree.org/schemas/pinctrl/qcom,qcs615-lpass-lpi-pinctrl.yaml#
$schema: http://devicetree.org/meta-schemas/core.yaml#

title: Qualcomm QCS615 LPASS LPI pin controller

maintainers:
  - Yassin Rezai <yassinrsocial@proton.me>

properties:
  compatible:
    const: qcom,qcs615-lpass-lpi-pinctrl

  reg:
    items:
      - description: LPASS LPI TLMM Control and Status registers

  clocks:
    items:
      - description: LPASS core hardware vote

  clock-names:
    items:
      - const: core

patternProperties:
  "-state$":
    oneOf:
      - $ref: "#/$defs/qcom-qcs615-lpass-state"
      - patternProperties:
          "-pins$":
            $ref: "#/$defs/qcom-qcs615-lpass-state"
        additionalProperties: false

$defs:
  qcom-qcs615-lpass-state:
    type: object
    $ref: qcom,lpass-lpi-common.yaml#/$defs/qcom-tlmm-state
    unevaluatedProperties: false
    properties:
      pins:
        items:
          pattern: "^gpio([0-9]|1[0-9]|2[0-9]|3[0-1])$"
      function:
        enum: [gpio, dmic1_clk, dmic1_data, dmic2_clk, dmic2_data,
               swr_tx_clk, swr_tx_data, swr_rx_clk, swr_rx_data,
               lpi_cdc_rst]

allOf:
  - $ref: qcom,lpass-lpi-common.yaml#

required:
  - compatible
  - reg
  - clocks
  - clock-names

unevaluatedProperties: false

examples:
  - |
    #include <dt-bindings/sound/qcom,q6dsp-lpass-ports.h>

    lpass_tlmm: pinctrl@62b40000 {
        compatible = "qcom,qcs615-lpass-lpi-pinctrl";
        reg = <0x62b40000 0x20000>;
        clocks = <&q6afecc LPASS_HW_MACRO_VOTE LPASS_CLK_ATTRIBUTE_COUPLE_NO>;
        clock-names = "core";
        gpio-controller;
        #gpio-cells = <2>;
        gpio-ranges = <&lpass_tlmm 0 0 32>;

        rx-swr-state {
            rx-clk-pins {
                pins = "gpio21";
                function = "swr_rx_clk";
            };
            rx-data-pins {
                pins = "gpio22", "gpio23";
                function = "swr_rx_data";
            };
        };
    };
```

## Documentation/devicetree/bindings/power/supply/qcom,pm6150-charger.yaml
```yaml
# SPDX-License-Identifier: (GPL-2.0-only OR BSD-2-Clause)
%YAML 1.2
---
$id: http://devicetree.org/schemas/power/supply/qcom,pm6150-charger.yaml#
$schema: http://devicetree.org/meta-schemas/core.yaml#

title: Qualcomm PM6150 SMB5 charger

maintainers:
  - Sebastian Reichel <sre@kernel.org>

description: |
  The PM6150 SMB5 block contains the battery buck charger, USB input source
  detection, AICL, battery interface and charger safety logic. Type-C and
  source VBUS are separate PM6150 devices and are not owned by this binding.

allOf:
  - $ref: power-supply.yaml#
  - $ref: /schemas/thermal/thermal-cooling-devices.yaml#

properties:
  compatible:
    const: qcom,pm6150-charger

  reg:
    maxItems: 1

  interrupts:
    minItems: 16
    maxItems: 16

  interrupt-names:
    items:
      - const: chg-state-change
      - const: bat-temp
      - const: bat-ov
      - const: bat-therm-or-id-missing
      - const: bat-terminal-missing
      - const: usbin-collapse
      - const: usbin-vashdn
      - const: usbin-uv
      - const: usbin-ov
      - const: usbin-plugin
      - const: usbin-src-change
      - const: usbin-icl-change
      - const: wdog-bark
      - const: aicl-done
      - const: temp-change
      - const: temp-change-smb

  io-channels:
    minItems: 3
    maxItems: 3

  io-channel-names:
    items:
      - const: usbin-v
      - const: batt-therm
      - const: batt-id

  input-current-limit-microamp:
    minimum: 100000
    maximum: 5000000
    description: Board-safe upper limit for USB input current.

  qcom,hard-jeita-hysteresis-celsius:
    $ref: /schemas/types.yaml#/definitions/uint32
    minimum: 1
    maximum: 20
    description:
      Temperature inside the battery hard operating range required before
      software re-enables charging after a hard hot or cold condition.

  '#cooling-cells':
    const: 2
    description:
      Cooling state 0 is normal charging, state 1 limits fast-charge current
      to 500 mA, and state 2 disables charging.

  monitored-battery: true

  power-supplies: true

required:
  - compatible
  - reg
  - interrupts
  - interrupt-names
  - io-channels
  - io-channel-names
  - input-current-limit-microamp
  - qcom,hard-jeita-hysteresis-celsius
  - monitored-battery
  - power-supplies

unevaluatedProperties: false
...
```
