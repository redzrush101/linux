## Documentation/devicetree/bindings/power/supply/qcom,pm6150-qg.yaml
```yaml
# SPDX-License-Identifier: (GPL-2.0-only OR BSD-2-Clause)
%YAML 1.2
---
$id: http://devicetree.org/schemas/power/supply/qcom,pm6150-qg.yaml#
$schema: http://devicetree.org/meta-schemas/core.yaml#

title: Qualcomm PM6150 QGauge fuel gauge

maintainers:
  - Yassin Rezai <yassinrsocial@proton.me>

description:
  The QGauge block found in PM6150 and related PMICs measures battery
  voltage and current and captures open-circuit voltage samples. It has no
  coulomb counter, so software estimates the state of charge from these
  samples and the battery OCV characteristics.

allOf:
  - $ref: power-supply.yaml#

properties:
  compatible:
    const: qcom,pm6150-qg

  reg:
    maxItems: 1

  interrupts:
    items:
      - description: battery missing
      - description: battery voltage low
      - description: battery voltage empty
      - description: measurement FIFO done
      - description: good OCV sample available

  interrupt-names:
    items:
      - const: qg-batt-missing
      - const: qg-vbat-low
      - const: qg-vbat-empty
      - const: qg-fifo-done
      - const: qg-good-ocv

  io-channels:
    items:
      - description: battery temperature

  io-channel-names:
    items:
      - const: batt-therm

  monitored-battery: true

  power-supplies: true

required:
  - compatible
  - reg
  - interrupts
  - interrupt-names
  - io-channels
  - io-channel-names
  - monitored-battery

unevaluatedProperties: false

examples:
  - |
    #include <dt-bindings/interrupt-controller/irq.h>

    pmic {
        #address-cells = <1>;
        #size-cells = <0>;

        fuel-gauge@4800 {
            compatible = "qcom,pm6150-qg";
            reg = <0x4800>;
            interrupts = <0x0 0x48 0x0 IRQ_TYPE_EDGE_BOTH>,
                         <0x0 0x48 0x1 IRQ_TYPE_EDGE_BOTH>,
                         <0x0 0x48 0x2 IRQ_TYPE_EDGE_RISING>,
                         <0x0 0x48 0x3 IRQ_TYPE_EDGE_RISING>,
                         <0x0 0x48 0x4 IRQ_TYPE_EDGE_RISING>;
            interrupt-names = "qg-batt-missing", "qg-vbat-low",
                              "qg-vbat-empty", "qg-fifo-done",
                              "qg-good-ocv";
            io-channels = <&bat_therm_sensor>;
            io-channel-names = "batt-therm";
            monitored-battery = <&battery>;
            power-supplies = <&pm6150_charger>;
        };
    };
...
```
